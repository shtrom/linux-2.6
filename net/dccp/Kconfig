## net/dccp/Kconfig
```kconfig
menuconfig IP_DCCP
	tristate "The DCCP Protocol (EXPERIMENTAL)"
	depends on INET && EXPERIMENTAL
	---help---
	  Datagram Congestion Control Protocol (RFC 4340)

	  From http://www.ietf.org/rfc/rfc4340.txt:

	  The Datagram Congestion Control Protocol (DCCP) is a transport
	  protocol that implements bidirectional, unicast connections of
	  congestion-controlled, unreliable datagrams. It should be suitable
	  for use by applications such as streaming media, Internet telephony,
	  and on-line games.

	  To compile this protocol support as a module, choose M here: the
	  module will be called dccp.

	  If in doubt, say N.

if IP_DCCP

config INET_DCCP_DIAG
	depends on INET_DIAG
	def_tristate y if (IP_DCCP = y && INET_DIAG = y)
	def_tristate m

config IP_DCCP_FREEZE
	bool "Freeze-DCCP"
	depends on EXPERIMENTAL
	---help---
	  Support for Freeze-DCCP to temporarily freeze the data flows.
	  Options can be sent to freeze both sides' senders or restore the
	  operation with a faster adaptation to the new conditions.
	  This can be used e.g. when the a mobile node and predicts a
	  disconnection to avoid losing packets.

	  Currently only implemented for TFRC (CCID3) [0].

	  [0] Olivier Mehani, Roksana Boreli and Thierry Ernst. Analysis of
	  TFRC in disconnected scenarios and performance improvements with
	  Freeze-DCCP. In ACM MobiArch 2009.

	  If in doubt, say N.

config IP_DCCP_FREEZE_DEBUG
	bool "Freeze-DCCP debug messages"
	depends on IP_DCCP_FREEZE
	default n
	help
	  Support for debug messages for Freeze-DCCP (and CCIDs).

source "net/dccp/ccids/Kconfig"

menu "DCCP Kernel Hacking"
	depends on DEBUG_KERNEL=y

config IP_DCCP_DEBUG
	bool "DCCP debug messages"
	---help---
	  Only use this if you're hacking DCCP.

	  When compiling DCCP as a module, this debugging output can be toggled
	  by setting the parameter dccp_debug of the `dccp' module to 0 or 1.

	  Just say N.

config NET_DCCPPROBE
	tristate "DCCP connection probing"
	depends on PROC_FS && KPROBES
	---help---
	This module allows for capturing the changes to DCCP connection
	state in response to incoming packets. It is used for debugging
	DCCP congestion avoidance modules. If you don't understand
	what was just said, you don't need it: say N.

	Documentation on how to use DCCP connection probing can be found
	at http://linux-net.osdl.org/index.php/DccpProbe

	To compile this code as a module, choose M here: the
	module will be called dccp_probe.


endmenu

endif # IP_DDCP
```

## net/dccp/ccids/Kconfig
```kconfig
menu "DCCP CCIDs Configuration (EXPERIMENTAL)"

config IP_DCCP_CCID2_DEBUG
	bool "CCID-2 debugging messages"
	---help---
	  Enable CCID-2 specific debugging messages.

	  The debugging output can additionally be toggled by setting the
	  ccid2_debug parameter to 0 or 1.

	  If in doubt, say N.

config IP_DCCP_CCID3
	bool "CCID-3 (TCP-Friendly)"
	def_bool y if (IP_DCCP = y || IP_DCCP = m)
	---help---
	  CCID-3 denotes TCP-Friendly Rate Control (TFRC), an equation-based
	  rate-controlled congestion control mechanism.  TFRC is designed to
	  be reasonably fair when competing for bandwidth with TCP-like flows,
	  where a flow is "reasonably fair" if its sending rate is generally
	  within a factor of two of the sending rate of a TCP flow under the
	  same conditions.  However, TFRC has a much lower variation of
	  throughput over time compared with TCP, which makes CCID-3 more
	  suitable than CCID-2 for applications such streaming media where a
	  relatively smooth sending rate is of importance.

	  CCID-3 is further described in RFC 4342,
	  http://www.ietf.org/rfc/rfc4342.txt

	  The TFRC congestion control algorithms were initially described in
	  RFC 5348.

	  This text was extracted from RFC 4340 (sec. 10.2),
	  http://www.ietf.org/rfc/rfc4340.txt

	  If in doubt, say N.

if IP_DCCP_CCID3
config IP_DCCP_CCID3_DEBUG
	bool "CCID-3 debugging messages"
	---help---
	  Enable CCID-3 specific debugging messages.

	  The debugging output can additionally be toggled by setting the
	  ccid3_debug parameter to 0 or 1.

	  If in doubt, say N.

choice
	prompt "Select method for measuring the packet size s"
	default IP_DCCP_CCID3_MEASURE_S_AS_MPS

config IP_DCCP_CCID3_MEASURE_S_AS_MPS
	bool "Always use MPS in place of s"
	---help---
	  This use is recommended as it is consistent with the initialisation
	  of X and suggested when s varies (rfc3448bis, (1) in section 4.1).
config IP_DCCP_CCID3_MEASURE_S_AS_AVG
	bool "Use moving average"
	---help---
	  An alternative way of tracking s, also supported by rfc3448bis.
	  This used to be the default for CCID-3 in previous kernels.
config IP_DCCP_CCID3_MEASURE_S_AS_MAX
	bool "Track the maximum payload length"
	---help---
	  An experimental method based on tracking the maximum packet size.
endchoice

config IP_DCCP_CCID3_RTO
	int "Use higher bound for nofeedback timer"
	default 100
	depends on IP_DCCP_CCID3
	---help---
	  Use higher lower bound for nofeedback timer expiration.

	  The TFRC nofeedback timer normally expires after the maximum of 4
	  RTTs and twice the current send interval (RFC 5348, 4.3). On LANs
	  with a small RTT this can mean a high processing load and reduced
	  performance, since then the nofeedback timer is triggered very
	  frequently.

	  This option enables to set a higher lower bound for the nofeedback
	  value. Values in units of milliseconds can be set here.

	  A value of 0 disables this feature by enforcing the value specified
	  in RFC 5348. The following values have been suggested as bounds for
	  experimental use:
	    * 16-20ms to match the typical multimedia inter-frame interval
	    * 100ms as a reasonable compromise [default]
	    * 1000ms corresponds to the lower TCP RTO bound (RFC 2988, 2.4)

	  The default of 100ms is a compromise between a large value for
	  efficient DCCP implementations, and a small value to avoid disrupting
	  the network in times of congestion.

	  The purpose of the nofeedback timer is to slow DCCP down when there
	  is serious network congestion: experimenting with larger values should
	  therefore not be performed on WANs.
endif	# IP_DCCP_CCID3

config IP_DCCP_TFRC_LIB
	def_bool y if IP_DCCP_CCID3

config IP_DCCP_TFRC_DEBUG
	def_bool y if IP_DCCP_CCID3_DEBUG

config IP_DCCP_CCID3_FREEZE
	def_bool y if IP_DCCP_FREEZE

config IP_DCCP_CCID3_FREEZE_DEBUG
	def_bool y if IP_DCCP_FREEZE_DEBUG

config IP_DCCP_CCID0
	bool "CCID-ZERO (UDP-like) sample kernel module"
	def_bool n
	---help---
	  This is a sample kernel module to illustrate the integration of new
	  CCID plugin modules into DCCP. It can also be used for performance
	  testing, but is not meant for deployment since it operates without
	  any congestion control. It is a no-op CCID, its identifier is 248.

	  Say N.

endmenu
```
